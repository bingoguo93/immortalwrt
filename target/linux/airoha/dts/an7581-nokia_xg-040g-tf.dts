// SPDX-License-Identifier: GPL-2.0-only OR MIT

#include "an7581-nokia_xg-040g-md-common-nwrt.dtsi"
#include "an7581-nokia_xg-040g-md-common-nwrt-ubi-parts.dtsi"
#include "an7581-npu.dtsi"

/ {
    model = "Nokia Bell XG-040G-TF";
    compatible = "nokia,xg-040g-tf", "airoha,an7581", "airoha,en7581";
};