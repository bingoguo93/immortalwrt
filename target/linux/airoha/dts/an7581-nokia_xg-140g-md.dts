// SPDX-License-Identifier: GPL-2.0-only OR MIT

#include "an7581-nokia_xg-040g-md-common-nwrt.dtsi"
#include "an7581-nokia_xg-040g-md-common-nwrt-ubi-parts.dtsi"
#include "an7581-npu.dtsi"

/ {
    model = "Nokia Bell XG-140G-MD";
    compatible = "nokia,xg-140g-md", "airoha,an7581", "airoha,en7581";
};
